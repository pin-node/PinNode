// PinNode for RetroPinUpgrade games (SPEC-node-link §5).
//
// The one include for a game: the types PinNodeGame.h (generated by pinnode-gen)
// relies on, and on the Mega the link (RPULink.h: RPULink_BeginUart / BeginSpi,
// Update) and the PinNode API (PinNodeCtrl.h: HELLO, game records, settings,
// audits, achievements, stats, start from the app, claim codes, Mega OTA).
//
// Install the library once (Library Manager, "Add .ZIP Library", or
// arduino-cli --library); don't copy these files into a sketch.
#pragma once

#include <stdint.h>
#ifndef PROGMEM
#  if defined(__AVR__)
#    include <avr/pgmspace.h>
#  else
#    define PROGMEM
#  endif
#endif

// Setting types (SPEC-game-manifest §5)
enum : uint8_t { PN_INT = 0, PN_BOOL = 1, PN_ENUM = 2, PN_SCORE = 3, PN_FLAGS = 4 };

// Setting flags
enum : uint8_t {
  PN_DIFFICULTY        = 1 << 0,  // changes which leaderboard games count on
  PN_OPERATOR_ONLY     = 1 << 1,  // only owner/staff may change it
  PN_LIVE_SAFE         = 1 << 2,  // may change mid-game
  PN_REQUIRES_PRESENCE = 1 << 3,  // never from the web (coil strengths etc.)
};

struct PinNodeSettingDef {
  uint8_t index;
  uint8_t type;           // PN_INT…
  int32_t min;
  int32_t max;
  int32_t def;
  uint8_t flags;          // PN_DIFFICULTY…
  const int32_t *values;  // PN_ENUM: allowed values (PROGMEM), else nullptr
  uint8_t valueCount;
  uint32_t bitMask;       // PN_FLAGS: the defined bits
};

#if defined(__cplusplus) && (defined(ARDUINO_ARCH_AVR) || defined(PINNODE_HOST_BUILD))
#include "RPULink.h"
#include "PinNodeCtrl.h"

// PINNODE_DISABLED: define it before including PinNode.h (best in the game's config header, so
// every file sees it) to build the game with no PinNode at all. Every call becomes an empty
// stand-in; none of the library is linked, so it costs no flash, RAM or time. The hooks stay
// in the code, ready for a build with PinNode. (Without it, a machine with no node still runs:
// the link goes quiet by itself; see RPULink_IsDormant.)
#ifdef PINNODE_DISABLED
#define RPULink_BeginUart(...)             ((void)0)
#define RPULink_BeginSpi(...)              ((void)0)
#define RPULink_SetHandler(...)            ((void)0)
#define RPULink_Update(...)                ((void)0)
#define RPULink_Poll(...)                  ((void)0)
#define RPULink_Queue(...)                 (false)
#define RPULink_QueueText(...)             (false)
#define RPULink_IsUp(...)                  (false)
#define RPULink_IsDormant(...)             (true)
#define RPULink_Pending(...)               (false)
#define RPULink_SetFlag(...)               ((void)0)
#define RPULink_DroppedRecords(...)        (0u)
#define RPULink_BadFrames(...)             (0u)
#define RPULink_RxOverruns(...)            (0u)
#define RPULink_RawRxBytes(...)            (0ul)
#define RPULink_RawTxBytes(...)            (0ul)
#define RPULink_FramingErrors(...)         (0u)
#define RPULink_DataOverruns(...)          (0u)
#define PinNodeCtrl_Begin(...)             ((void)0)
#define PinNodeCtrl_SetOtaHandler(...)     ((void)0)
#define PinNodeCtrl_DebugTo(...)           ((void)0)
#define PinNodeCtrl_BuildId(...)           (0ul)
#define PinNodeCtrl_Update(...)            ((void)0)
#define PinNodeCtrl_Log(...)               ((void)0)
#define PinNodeCtrl_NodeRequest(...)       ((void)0)
#define PinNode_AdjustmentRange(...)       (false)
#define PinNode_AdjustmentEeprom(...)      (false)
#define PINNODE_NUM_ADJUSTMENTS            0
#define PinNode_AppStartsOn(...)           (true)
#define PinNodeCtrl_TimeKnown(...)         (false)
#define PinNodeCtrl_UnixTime(...)          (0ul)
#define PinNodeCtrl_Mode(...)              ((void)0)
#define PinNodeCtrl_GameStart(...)         ((void)0)
#define PinNodeCtrl_PlayerAdded(...)       ((void)0)
#define PinNodeCtrl_BallStart(...)         ((void)0)
#define PinNodeCtrl_BallEnd(...)           ((void)0)
#define PinNodeCtrl_GameEnd(...)           ((void)0)
#define PinNodeCtrl_Coin(...)              ((void)0)
#define PinNodeCtrl_TakeStartRequest(...)  (false)
#define PinNodeCtrl_TakeAppStart(...)      (false)
#define PinNodeCtrl_ActionFlags(...)       ((byte)0)
#define PinNodeCtrl_OriginalChosen()       (false)
#define RPULink_DropQueued()               ((void)0)
#define PinNodeCtrl_SetBootTarget(...)     ((void)0)
#define PinNodeCtrl_SetHello(...)          ((void)0)
#define PinNodeCtrl_SetRecordHook(...)     ((void)0)
#define PinNodeCtrl_Credits(...)           ((void)0)
#define PinNodeCtrl_TakeCreditAdd(...)     (false)
#define PinNodeCtrl_CreditResult(...)      ((void)0)
#define PinNodeCtrl_StartResult(...)       ((void)0)
#define PinNodeCtrl_Settings(...)          ((void)0)
#define PinNodeCtrl_SettingsChanged(...)   ((void)0)
#define PinNodeCtrl_SettingsLocked(...)    (false)
#define PinNodeCtrl_SettingLocked(...)     (false)
#define PinNodeCtrl_Audits(...)            ((void)0)
#define PinNodeCtrl_AuditsChanged(...)     ((void)0)
#define PinNodeCtrl_ClearAudits(...)       (0L)
#define PinNodeCtrl_ClaimCode(...)         (false)
#define PinNodeCtrl_Achievement(...)       ((void)0)
#define PinNodeCtrl_Stat(...)              ((void)0)
#define PinNodeCtrl_Actions(...)           ((void)0)
#define PinNodeCtrl_TakeAction(...)        (false)
#define PinNodeCtrl_SendAuditsNow()        (false)
#define PinNodeCtrl_ActionResult(...)      ((void)0)
#define PinNodeCtrl_SwitchEvent(...)       ((void)0)
#define PinNodeCtrl_Tilt(...)              ((void)0)
#define PinNodeCtrl_GameCounter(...)       ((uint16_t)0)
#define PinNodeCtrl_NodeStatus(...)        (false)
#define PinNodeCtrl_CheckedIn(...)         (false)
#define PinNodeCtrl_NodeMessage()          ((const char *)0)
#define PinNodeCtrl_LastMode(...)          ((byte)0xFF)
#endif
#endif

// ------------------------------------------------------------------ claim codes on the displays
// For RPU games: include RPU.h before this header (the converter does), or this part is left out. After a game, each player nobody checked in
// as gets a 6-digit claim code from the node. Call PinNode_ShowClaimCodes() last in every attract
// pass: for each such player it owns that player's score display until the code is claimed or the
// window ends, showing
//   the code for 5 s, blinking (so it never reads as a score), then the score for 2 s, and so on;
// and, if you pass the four "player up" lamps, flashes that player's lamp while the code is up.
// It returns one bit per display it drew (bit 0 = player 1): skip those in your own score drawing.
// At game start call PinNode_ClaimCodesStop(), so a flashing player-up lamp doesn't carry into play.
// PinNode_ClaimCodesShowing() is true while any player has a code up: hold off attract displays
// that cover every score window (the high score, say) until it's claimed or the window ends.
// The converter (pinnode-gen convert) adds both calls; hand-written games use the same calls.
#if defined(__cplusplus) && defined(RPU_OS_H)
#ifndef PINNODE_CLAIM_CODE_MS
#define PINNODE_CLAIM_CODE_MS   5000UL
#endif
#ifndef PINNODE_CLAIM_SCORE_MS
#define PINNODE_CLAIM_SCORE_MS  2000UL
#endif
#ifdef PINNODE_DISABLED
#define PinNode_ShowClaimCodes(...)        ((byte)0)
#define PinNode_ClaimCodesStop()           ((void)0)
#define PinNode_ClaimCodesShowing()        (false)
#else
inline bool PinNode_ClaimCodesShowing() {
  unsigned long code;
  for (byte p = 1; p <= 4; p++)
    if (PinNodeCtrl_ClaimCode(p, &code)) return true;
  return false;
}

struct PinNodeClaimShow { byte lampsOn, owned; const byte *lamps; };
#ifdef RPU_NUMBER_OF_PLAYER_DISPLAYS
#define PINNODE_PLAYER_DISPLAYS RPU_NUMBER_OF_PLAYER_DISPLAYS
#else
#define PINNODE_PLAYER_DISPLAYS 4                    // older RPU (the 2022 games) has no such define: four
#endif

inline PinNodeClaimShow &PinNode_ClaimShowState() { static PinNodeClaimShow s; return s; }

inline byte PinNode_ShowClaimCodes(unsigned long now, const unsigned long *scores,
                                   const byte *playerUpLamps = 0) {
  PinNodeClaimShow &st = PinNode_ClaimShowState();
  byte &lampsOn = st.lampsOn, &owned = st.owned;
  st.lamps = playerUpLamps;
  byte drawn = 0;
  bool codeTurn = (now % (PINNODE_CLAIM_CODE_MS + PINNODE_CLAIM_SCORE_MS)) < PINNODE_CLAIM_CODE_MS;
  bool lit = (now % 600) < 450;                      // the code blinks: 450 ms on, 150 ms off
  for (byte p = 1; p <= 4 && p <= PINNODE_PLAYER_DISPLAYS; p++) {
    unsigned long code;
    bool has = PinNodeCtrl_ClaimCode(p, &code);
    if (has) {
      if (!codeTurn) RPU_SetDisplay(p - 1, scores[p - 1], true, 2);
      else if (lit) RPU_SetDisplay(p - 1, code, true, 6);
      else RPU_SetDisplayBlank(p - 1, 0x00);
      drawn |= 1 << (p - 1);
    } else if ((owned >> (p - 1)) & 1) {
      RPU_SetDisplay(p - 1, scores[p - 1], true, 2);  // claimed or timed out: give the score back
    }
    // the lamp is set again on every pass of the code's turn, since attract code often turns lamps
    // off (all player-up lamps, or RPU_TurnOffAllLamps); off is written once, so we don't fight a game
    bool lamp = has && codeTurn;
    if (playerUpLamps && (lamp || ((lampsOn >> (p - 1)) & 1))) {
      RPU_SetLampState(playerUpLamps[p - 1], lamp, 0, lamp ? 150 : 0);
      if (lamp) lampsOn |= 1 << (p - 1);
      else lampsOn &= ~(1 << (p - 1));
    }
  }
  owned = drawn;
  return drawn;
}

inline void PinNode_ClaimCodesStop() {
  PinNodeClaimShow &st = PinNode_ClaimShowState();
  for (byte p = 0; p < 4 && st.lamps; p++)
    if ((st.lampsOn >> p) & 1) RPU_SetLampState(st.lamps[p], 0);
  st.lampsOn = st.owned = 0;
}
#endif
#endif

// ---- The PinNode adjustments in an RPU OperatorMenus game (the RPU example game's menus). Two lines in
// the game-adjustments menu, and every PinNode adjustment shows after the game's own, now and in later
// library versions (the converter places both):
//   Menus.SetNumSubLevels(OM_GAME_ADJ_FINISHED + PINNODE_NUM_ADJUSTMENTS);
//   switch (subLevel) { ...the game's items...
//     default: PINNODE_ADJUSTMENT_ITEM(subLevel - OM_GAME_ADJ_FINISHED); break;
//   }
// It uses the menu code's own locals (adjustmentType, adjustmentValues, currentAdjustmentByte,
// currentAdjustmentStorageByte). The library keeps and saves the values itself (storage byte 0).
#define PINNODE_ADJUSTMENT_ITEM(index)                                                          \
  if (PinNode_AdjustmentRange((byte)(index), adjustmentValues, &currentAdjustmentByte)) {      \
    adjustmentType = OPERATOR_MENU_ADJ_TYPE_MIN_MAX;                                           \
    currentAdjustmentStorageByte = 0;                                                          \
  }
// The same in an older RPU game whose self-test chains adjustments as MACHINE_STATE_ADJUST_* states
// (SelfTestAndAudit games such as SpaceBattle2022): MACHINE_STATE_ADJUST_DONE moves down by
// PINNODE_NUM_ADJUSTMENTS, and the adjustment switch gets
//     default: PINNODE_ADJUSTMENT_ITEM_CHAINED(PINNODE_ADJ_FIRST_STATE - curState); break;
// with PINNODE_ADJ_FIRST_STATE = the old MACHINE_STATE_ADJUST_DONE (the converter writes both).
#define PINNODE_ADJUSTMENT_ITEM_CHAINED(index)                                                  \
  if (PinNode_AdjustmentRange((byte)(index), AdjustmentValues, &CurrentAdjustmentByte)) {      \
    AdjustmentType = ADJ_TYPE_MIN_MAX;                                                         \
    CurrentAdjustmentStorageByte = 0;                                                          \
  }

// ------------------------------------------------------------------ the operator menu (RPU games)
// The self-test switch on Bally/Stern MPUs is an interrupt flag, not a matrix switch: one stray
// pulse (or a press) mid-game opened the operator menu, whose first page is blank and stops the
// game until the credit button (found on the Star Trek, 2026-10-04). Two helpers for games built
// on the RPU ExampleMachine's OperatorMenus; the converter adds both.
#if defined(__cplusplus) && defined(RPU_OS_H)
#ifndef PINNODE_SELF_TEST_GAP_MIN_MS
#define PINNODE_SELF_TEST_GAP_MIN_MS  300UL     // one press can raise the flag more than once
#endif
#ifndef PINNODE_SELF_TEST_GAP_MAX_MS
#define PINNODE_SELF_TEST_GAP_MAX_MS  3000UL
#endif
#ifndef PINNODE_MENU_IDLE_EXIT_MS
#define PINNODE_MENU_IDLE_EXIT_MS     15000UL
#endif

// In the game's switch handler: true when the self-test switch should open the menu. Outside a game
// one press does, as operators expect; during a game it takes two presses 0.3 to 3 s apart.
//   if (PinNode_SelfTestOpens(MachineState > MACHINE_STATE_ATTRACT, CurrentTime)) Menus.EnterOperatorMenu();
inline boolean PinNode_SelfTestOpens(boolean inGame, unsigned long now) {
  static unsigned long last;
  if (!inGame) { last = 0; return true; }
  unsigned long gap = now - last;
  if (last && gap > PINNODE_SELF_TEST_GAP_MIN_MS && gap < PINNODE_SELF_TEST_GAP_MAX_MS) {
    last = 0;
    return true;
  }
  last = now ? now : 1;
  return false;
}

// Each pass of the operator menu, after Menus.UpdateMenu(): true when it has just closed the menu
// (Menus.ExitOperatorMenu()), so run the game's "menu is done" code. It closes the blank first page
// (top level 0, "return to game") after 15 s, and on the phone's exit-diagnostics action; other
// actions get NOT_NOW while the menu is open.
//   if (!Menus.UpdateMenu(CurrentTime) || PinNode_OperatorMenuGuard(Menus, CurrentTime)) { ...done... }
template <class M> inline boolean PinNode_OperatorMenuGuard(M &menus, unsigned long now) {
  static unsigned long firstPageSince, lastPass;
  if (now - lastPass > 500) firstPageSince = 0;    // the menu was closed since: a fresh visit
  lastPass = now;
  boolean exit = false;
  if (menus.GetTopLevel() == 0) {
    if (!firstPageSince) firstPageSince = now ? now : 1;
    else if (now - firstPageSince > PINNODE_MENU_IDLE_EXIT_MS) exit = true;
  } else {
    firstPageSince = 0;
  }
#ifndef PINNODE_DISABLED
  PinNodeActionRequest r;
  if (!exit && PinNodeCtrl_TakeAction(&r)) {
    if (r.op == PINNODE_OP_START && (PinNodeCtrl_ActionFlags(r.action) & PINNODE_ACTION_EXIT_DIAG)) {
      exit = true;
      PinNodeCtrl_ActionResult(r.reqId, r.action, PINNODE_ACTION_DONE, 0, PINNODE_REASON_FINISHED);
    } else {
      PinNodeCtrl_ActionResult(r.reqId, r.action, r.op == PINNODE_OP_STOP ? PINNODE_ACTION_DONE : PINNODE_ACTION_NOT_NOW,
                               0, r.reason);
    }
  }
#endif
  if (exit) {
    menus.ExitOperatorMenu();
    firstPageSince = 0;
  }
  return exit;
}
#endif

// ------------------------------------------------------------------ tests from the phone (RPU games)
// The operator's tests on the phone, for any RPU-OS game, with one call in loop() and one in setup()
// (the converter adds both). The phone puts the machine into PinNode's own diagnostics state from
// attract; while it's there the game's attract and game code don't run, and the library runs the
// tests with the RPU OS calls the coin-door menu uses. Leaving it returns the game to attract.
//   setup(), before PinNodeCtrl_Begin:
//     PinNode_TestsBegin(SolenoidConvertDisplayNumberToIndex, SolenoidConvertDisplayNumberToTestStrength, 0);
//       (the game's own Menus.SetSolenoid...Callback functions, or 0 for the menu's defaults: coils 1-15
//        at strength 5; the third is Menus.SetSoundCallbackFunction's, or 0 for no sound test)
//   loop(), first in the machine-state chain:
//     if (PinNode_Tests(CurrentTime, &newMachineState, MACHINE_STATE_ATTRACT)) {
//     } else if (MachineState == MACHINE_STATE_ATTRACT) { ...
// The actions, in this order, are the manifest's actions[] (the converter writes both):
//   0 lamp-test      arg: lamp number, PINNODE_TEST_ALL_LAMPS or more = all lamps flashing
//   1 display-test   arg: 0 = every digit counting, 1-7 = that digit
//   2 solenoid-test  arg: a coil number from the game's coil test; any other = each in turn, every 2 s
//   3 switch-test    reports each switch that opens or closes; the value counts closures
//   4 clear-audits   (confirm) the audits go to the node first, then to 0
//   5 enter-diagnostics, 6 exit-diagnostics
//   7 sound-test     arg: the sound number for the game's sound test (only with a sound callback)
// The library stops a test after 60 s without the phone, or 3 s without the link, and leaves
// diagnostics after 5 min with nothing running.
#if defined(__cplusplus) && defined(RPU_OS_H)
#ifndef PINNODE_MACHINE_STATE_TESTS
#define PINNODE_MACHINE_STATE_TESTS   125      // PinNode's diagnostics state: pick another if the game uses 125
#endif
#define PINNODE_TEST_LAMPS            0
#define PINNODE_TEST_DISPLAYS         1
#define PINNODE_TEST_SOLENOIDS        2
#define PINNODE_TEST_SWITCHES         3
#define PINNODE_TEST_CLEAR_AUDITS     4
#define PINNODE_TEST_ENTER            5
#define PINNODE_TEST_EXIT             6
#define PINNODE_TEST_SOUNDS           7
#define PINNODE_TEST_NONE             0xFF
#if defined(RPU_MPU_ARCHITECTURE) && RPU_MPU_ARCHITECTURE >= 10
#define PINNODE_TEST_ALL_LAMPS        64       // the RPU OS's lamp count: Williams 64, Bally/Stern 60
#else
#define PINNODE_TEST_ALL_LAMPS        60
#endif
#define PINNODE_TEST_COIL_PERIOD_MS   2000UL
#ifdef RPU_OS_ALL_DIGITS_MASK
#define PINNODE_ALL_DIGITS            RPU_OS_ALL_DIGITS_MASK
#elif defined(RPU_OS_NUM_DIGITS) && RPU_OS_NUM_DIGITS == 7
#define PINNODE_ALL_DIGITS            0x7F
#else
#define PINNODE_ALL_DIGITS            0x3F     // six digits
#endif
#define PINNODE_TEST_SWITCHES_POLLED  64

struct PinNodeTestState {
  unsigned short (*coil)(byte);        // the coil test's number -> solenoid (0xFD unused, 0xFE past the end)
  byte (*strength)(byte);
  byte (*sound)(byte);
  byte test;                           // running, or PINNODE_TEST_NONE
  uint16_t reqId;
  long arg, value;
  unsigned long lastStep;
  byte switches[PINNODE_TEST_SWITCHES_POLLED / 8];
  boolean firstPass;
};
inline PinNodeTestState &PinNode_TestState() {
  static PinNodeTestState t = {0, 0, 0, PINNODE_TEST_NONE, 0, 0, 0, 0, {0}, false};
  return t;
}
inline unsigned short PinNode_TestCoil(byte n) {           // the coin-door menu's defaults
  PinNodeTestState &t = PinNode_TestState();
  if (t.coil) return t.coil(n);
  return n == 0 ? 0xFD : n < 16 ? n - 1 : 0xFE;
}
inline byte PinNode_TestStrength(byte n) {
  PinNodeTestState &t = PinNode_TestState();
  byte s = t.strength ? t.strength(n) : 5;
  return s >= 0xFD ? 4 : s;
}

inline void PinNode_TestsBegin(unsigned short (*coil)(byte), byte (*strength)(byte), byte (*sound)(byte)) {
  PinNodeTestState &t = PinNode_TestState();
  t.coil = coil;
  t.strength = strength;
  t.sound = sound;
  static const PinNodeAction actions[] = {
    {PINNODE_ACTION_TEST | PINNODE_ACTION_LOCAL},             // lamp-test
    {PINNODE_ACTION_TEST | PINNODE_ACTION_LOCAL},             // display-test
    {PINNODE_ACTION_TEST | PINNODE_ACTION_LOCAL},             // solenoid-test
    {PINNODE_ACTION_TEST | PINNODE_ACTION_LOCAL},             // switch-test
    {PINNODE_ACTION_CONFIRM},                                 // clear-audits
    {PINNODE_ACTION_LOCAL | PINNODE_ACTION_ENTER_DIAG},       // enter-diagnostics
    {PINNODE_ACTION_LOCAL | PINNODE_ACTION_EXIT_DIAG},        // exit-diagnostics
    {PINNODE_ACTION_TEST | PINNODE_ACTION_LOCAL},             // sound-test
  };
  PinNodeCtrl_Actions(actions, sound ? 8 : 7);
}

inline void PinNode_TestStop() {
  PinNodeTestState &t = PinNode_TestState();
  if (t.test == PINNODE_TEST_NONE) return;
  RPU_TurnOffAllLamps();
  for (byte d = 0; d < PINNODE_PLAYER_DISPLAYS; d++) RPU_SetDisplayBlank(d, 0x00);
  t.test = PINNODE_TEST_NONE;
}

// Start (or switch to) a test; answers what the app shows
inline void PinNode_TestStart(byte test, long arg) {
  PinNodeTestState &t = PinNode_TestState();
  if (t.test != PINNODE_TEST_NONE && t.test != test) PinNode_TestStop();
  RPU_TurnOffAllLamps();
  t.test = test;
  t.arg = arg;
  t.lastStep = 0;
  if (test == PINNODE_TEST_LAMPS) {
    if (arg < 0 || arg >= PINNODE_TEST_ALL_LAMPS) {
      for (int l = 0; l < PINNODE_TEST_ALL_LAMPS; l++) RPU_SetLampState(l, 1, 0, 500);
      arg = PINNODE_TEST_ALL_LAMPS;
    } else {
      RPU_SetLampState((int)arg, 1);
    }
    t.value = arg;
  } else if (test == PINNODE_TEST_DISPLAYS) {
    t.value = (arg < 0 || arg > 7) ? 0 : arg;
    // Every digit counting: the RPU OS's cycle doesn't touch blanking, and the test's entry and the
    // game's attract (unused players) leave displays blank, so turn every player display fully on
    if (t.value == 0) for (byte d = 0; d < PINNODE_PLAYER_DISPLAYS; d++) RPU_SetDisplayBlank(d, PINNODE_ALL_DIGITS);
  } else if (test == PINNODE_TEST_SOLENOIDS) {
    t.value = 0;
    for (byte n = 1; n < 32 && arg > 0; n++) {               // a coil of the game's coil test, or each in turn
      unsigned short c = PinNode_TestCoil(n);
      if (c == 0xFE) break;
      if (c != 0xFD && !(c & 0xFF00) && n == arg) { t.value = n; break; }
    }
  } else if (test == PINNODE_TEST_SWITCHES) {
    for (byte i = 0; i < sizeof(t.switches); i++) t.switches[i] = 0;
    t.value = 0;
    t.firstPass = true;                // switches already closed are reported, not counted
  } else if (test == PINNODE_TEST_SOUNDS) {
    t.value = arg;
    if (t.sound) t.sound((byte)arg);
  }
}

// Each pass, while the test runs
inline void PinNode_TestRun(unsigned long now) {
  PinNodeTestState &t = PinNode_TestState();
  if (t.test == PINNODE_TEST_DISPLAYS) {
    RPU_CycleAllDisplays(now, (byte)t.value);
  } else if (t.test == PINNODE_TEST_SOLENOIDS) {
    if (t.lastStep && now - t.lastStep < PINNODE_TEST_COIL_PERIOD_MS) return;
    t.lastStep = now ? now : 1;
    byte n = (byte)t.value;
    if (t.arg <= 0 || t.value != t.arg) {                    // each in turn: the next coil the test knows
      for (byte tries = 0; tries < 32; tries++) {
        n = n >= 31 ? 1 : n + 1;
        unsigned short c = PinNode_TestCoil(n);
        if (c == 0xFE) { n = 0; continue; }
        if (c != 0xFD && !(c & 0xFF00)) break;
      }
      t.value = n;
      PinNodeCtrl_ActionResult(t.reqId, PINNODE_TEST_SOLENOIDS, PINNODE_ACTION_OK, t.value);   // which coil now
    }
    unsigned short c = PinNode_TestCoil(n);
    if (c < 0xFD) RPU_PushToSolenoidStack((byte)c, PinNode_TestStrength(n), true);
  } else if (t.test == PINNODE_TEST_SWITCHES) {
    for (byte sw = 0; sw < PINNODE_TEST_SWITCHES_POLLED; sw++) {
      boolean closed = RPU_ReadSingleSwitchState(sw);
      boolean was = (t.switches[sw / 8] >> (sw % 8)) & 1;
      if (closed == was) continue;
      if (closed) { t.switches[sw / 8] |= (1 << (sw % 8)); if (!t.firstPass) t.value += 1; }
      else t.switches[sw / 8] &= ~(1 << (sw % 8));
      PinNodeCtrl_SwitchEvent(sw, closed);
    }
    t.firstPass = false;
  }
}

// In loop(), first in the machine-state chain. True while the phone's diagnostics has the machine
// (skip the game's own state code this pass). *state is the game's newMachineState.
inline boolean PinNode_Tests(unsigned long now, int *state, int attract) {
#ifdef PINNODE_DISABLED
  return false;
#else
  PinNodeTestState &t = PinNode_TestState();
  boolean diag = *state == PINNODE_MACHINE_STATE_TESTS;
  if (!diag && *state != attract) return false;            // in a game: the library answers "not now"
  PinNodeActionRequest r;
  if (PinNodeCtrl_TakeAction(&r)) {
    boolean isTest = r.action <= PINNODE_TEST_SWITCHES || (r.action == PINNODE_TEST_SOUNDS && t.sound);
    if (r.op == PINNODE_OP_STOP) {
      long v = t.value;
      if (t.test == r.action) PinNode_TestStop();
      PinNodeCtrl_ActionResult(r.reqId, r.action, PINNODE_ACTION_DONE, v, r.reason);
    } else if (isTest) {
      if (!diag) PinNodeCtrl_ActionResult(r.reqId, r.action, PINNODE_ACTION_NOT_NOW, 0);
      else {
        t.reqId = r.reqId;
        PinNode_TestStart(r.action, r.arg);
        PinNodeCtrl_ActionResult(r.reqId, r.action, PINNODE_ACTION_OK, t.value);
      }
    } else if (r.action == PINNODE_TEST_CLEAR_AUDITS) {
      PinNodeCtrl_ActionResult(r.reqId, r.action, PINNODE_ACTION_DONE, PinNodeCtrl_ClearAudits(), PINNODE_REASON_FINISHED);
    } else if (r.action == PINNODE_TEST_ENTER) {
      if (!diag) {
        RPU_TurnOffAllLamps();
        for (byte d = 0; d < PINNODE_PLAYER_DISPLAYS; d++) RPU_SetDisplayBlank(d, 0x00);
        RPU_EnableSolenoidStack();
        *state = PINNODE_MACHINE_STATE_TESTS;
        diag = true;
      }
      PinNodeCtrl_ActionResult(r.reqId, r.action, PINNODE_ACTION_DONE, 0, PINNODE_REASON_FINISHED);
    } else if (r.action == PINNODE_TEST_EXIT) {
      if (diag) {
        if (t.test != PINNODE_TEST_NONE) {
          byte running = t.test;
          long v = t.value;
          PinNode_TestStop();
          PinNodeCtrl_ActionResult(t.reqId, running, PINNODE_ACTION_DONE, v, PINNODE_REASON_DIAGNOSTICS);
        }
        RPU_TurnOffAllLamps();
        RPU_DisableSolenoidStack();
        while (RPU_PullFirstFromSwitchStack() != SWITCH_STACK_EMPTY) {}   // nothing pressed here reaches attract
        *state = attract;              // the game's attract starts afresh next pass
      }
      if (r.reqId) PinNodeCtrl_ActionResult(r.reqId, r.action, PINNODE_ACTION_DONE, 0, PINNODE_REASON_FINISHED);
      return true;
    } else {
      PinNodeCtrl_ActionResult(r.reqId, r.action, PINNODE_ACTION_UNKNOWN, 0);
    }
  }
  if (!diag) return false;
  PinNode_TestRun(now);
  while (RPU_PullFirstFromSwitchStack() != SWITCH_STACK_EMPTY) {}
  return true;
#endif
}
#endif

// ------------------------------------------------------------------ boot the original game (RPU Rev 4+)
// An owner can switch the machine between this game and its original ROM game from the app or the
// web (BOOT_SELECT). Around RPU_InitializeMPU (the converter adds all three):
//   initOptions = PinNode_BootOptions(initOptions);              // before
//   initResult = RPU_InitializeMPU(initOptions, SW_CREDIT_RESET);
//   PinNode_BootChosen(initResult);                               // after
//   if (initResult & RPU_RET_ORIGINAL_CODE_REQUESTED) { ...start the link...; PinNode_RunOriginal(); }
// With the original chosen, holding Credit/Reset at power-on boots this game and clears the choice,
// so a machine can't be stuck if the node or the service is down. Other boot options (the board's
// selector switch) are left as the game set them.
#if defined(__cplusplus) && defined(RPU_OS_H)
#if defined(PINNODE_DISABLED) || !defined(RPU_CMD_INIT_AND_RETURN_EVEN_IF_ORIGINAL_CHOSEN)
// (an RPU OS older than the boot-original commands: nothing to switch, the game always boots)
#define PinNode_BootOptions(o)             (o)
#define PinNode_BootChosen(...)            ((void)0)
#define PinNode_RunOriginal(...)           do { for (;;) {} } while (0)
#else
inline unsigned long PinNode_BootOptions(unsigned long options) {
  if (!PinNodeCtrl_OriginalChosen()) return options;
  return (options & ~(unsigned long)RPU_CMD_BOOT_ORIGINAL_IF_CREDIT_RESET) |
         RPU_CMD_BOOT_ORIGINAL_IF_NOT_CREDIT_RESET | RPU_CMD_INIT_AND_RETURN_EVEN_IF_ORIGINAL_CHOSEN;
}

inline void PinNode_BootChosen(unsigned long initResult) {
  // the original was chosen but this game booted: Credit/Reset held at power-on, the local way back
  if (PinNodeCtrl_OriginalChosen() && !(initResult & RPU_RET_ORIGINAL_CODE_REQUESTED)) PinNodeCtrl_SetBootTarget(0);
}

// While the original game runs (no scores, settings or credits): keep the link up (mode
// original) and take the switch back. Never returns. idle, if given, runs every pass (e.g. an accessory
// lamp board's watchdog).
inline void PinNode_RunOriginal(void (*idle)(void) = 0) {
  for (;;) {
    unsigned long now = millis();
    RPULink_Update(now);
    PinNodeCtrl_Mode(PINNODE_MODE_ORIGINAL, 0, 0);
    PinNodeCtrl_Update(now, false);
    if (idle) idle();
  }
}
#endif
#endif

// ------------------------------------------------------------------ status on the board's OLED
// RPU Rev 4 and 102 have a header for a 128x64 I2C OLED on the Mega's SDA/SCL (D20/D21). With
// #define PINNODE_OLED before including PinNode.h (and the U8g2 library installed), it shows:
// the link to the node, WiFi and cloud, the node's messages ("NOT SET UP"), the mode, who's
// checked in, claim codes, and what a phone test is doing. 1.3" boards are usually SH1106 (the
// default); for a 0.96" SSD1306 also #define PINNODE_OLED_SSD1306. Text mode, no screen buffer:
// about 380 bytes of RAM (with the I2C driver) and 6 KB of flash. Call PinNode_OledBegin() in setup() and PinNode_OledUpdate(now) every
// loop pass: it redraws at most one changed line per pass (a few ms), so the game never stalls.
// Without PINNODE_OLED both calls are empty, so the converter can place them in every game.
#if defined(__cplusplus) && defined(RPU_OS_H)
#if defined(PINNODE_OLED) && !defined(PINNODE_DISABLED)
#include <U8x8lib.h>
#ifdef PINNODE_OLED_SSD1306
inline U8X8 &PinNode_Oled() { static U8X8_SSD1306_128X64_NONAME_HW_I2C d(U8X8_PIN_NONE); return d; }
#else
inline U8X8 &PinNode_Oled() { static U8X8_SH1106_128X64_NONAME_HW_I2C d(U8X8_PIN_NONE); return d; }
#endif
struct PinNodeOledState { uint16_t shown[8]; byte next; unsigned long lastMs; };   // a checksum per row, not the text
inline PinNodeOledState &PinNode_OledState() { static PinNodeOledState s; return s; }

inline void PinNode_OledBegin() {
  U8X8 &d = PinNode_Oled();
  d.begin();
  d.setBusClock(400000);
  d.setFont(u8x8_font_chroma48medium8_r);
  d.clearDisplay();
  PinNodeOledState &s = PinNode_OledState();
  for (byte r = 0; r < 8; r++) s.shown[r] = 0xFFFF;
}

// The text for one row, 16 characters
inline void PinNode_OledLine(byte row, char *t, unsigned long now) {
  for (byte i = 0; i < 16; i++) t[i] = ' ';
  t[16] = 0;
  char b[17];
  b[0] = 0;
  if (row == 0) {
    snprintf_P(b, sizeof b, PSTR("PinNode %S"), RPULink_IsUp() ? PSTR("link ok") : RPULink_IsDormant() ? PSTR("no node") : PSTR("..."));
  } else if (row == 1) {
    byte w, c;
    if (PinNodeCtrl_NodeStatus(&w, &c)) snprintf_P(b, sizeof b, PSTR("WiFi %S Cloud %S"), w ? PSTR("ok") : PSTR("--"), c ? PSTR("ok") : PSTR("--"));
    else if (RPULink_IsUp()) snprintf_P(b, sizeof b, PSTR("WiFi ? Cloud ?"));
  } else if (row == 2) {
    const char *m = PinNodeCtrl_NodeMessage();
    if (m) {                                            // "PINNODE  NOT SET UP": drop the prefix, it's on row 0
      if (!strncmp(m, "PINNODE", 7)) { m += 7; while (*m == ' ') m++; }
      snprintf_P(b, sizeof b, PSTR("%s"), m);
    }
  } else if (row == 3) {
    byte ball, slot, mode = PinNodeCtrl_LastMode(&ball, &slot);
    PinNodeTestState &ts = PinNode_TestState();
    if (ts.test != PINNODE_TEST_NONE) {
      const char *n = ts.test == PINNODE_TEST_LAMPS ? PSTR("Lamp test") : ts.test == PINNODE_TEST_DISPLAYS ? PSTR("Display test")
                    : ts.test == PINNODE_TEST_SOLENOIDS ? PSTR("Coil test") : ts.test == PINNODE_TEST_SWITCHES ? PSTR("Switch test")
                    : ts.test == PINNODE_TEST_SOUNDS ? PSTR("Sound test") : PSTR("Test");
      snprintf_P(b, sizeof b, PSTR("%S %ld"), n, (long)ts.value);
    } else if (mode == PINNODE_MODE_GAME) snprintf_P(b, sizeof b, PSTR("Game  ball %u P%u"), ball, slot);
    else if (mode == PINNODE_MODE_ATTRACT) snprintf_P(b, sizeof b, PSTR("Attract"));
    else if (mode == PINNODE_MODE_SERVICE) snprintf_P(b, sizeof b, PSTR("Operator menu"));
  } else if (row == 4 || row == 5) {                    // check-ins: 1-2 on row 4, 3-4 on row 5
    char a[4], c[4];
    byte p = row == 4 ? 1 : 3;
    boolean ha = PinNodeCtrl_CheckedIn(p, a), hc = PinNodeCtrl_CheckedIn(p + 1, c);
    if (!ha) { a[0] = '-'; a[1] = 0; }
    if (!hc) { c[0] = '-'; c[1] = 0; }
    if (ha || hc) snprintf_P(b, sizeof b, PSTR("%u %-3s   %u %-3s"), p, a, p + 1, c);
    else if (row == 4 && PinNodeCtrl_CheckedIn(0, a)) snprintf_P(b, sizeof b, PSTR("Next game: %s"), a);
  } else if (row == 6) {                                // claim codes, one at a time
    unsigned long code;
    byte n = 0, which = (byte)((now / 3000UL) % 4);
    for (byte k = 0; k < 4; k++) {
      byte p = (byte)((which + k) % 4) + 1;
      if (PinNodeCtrl_ClaimCode(p, &code)) { snprintf_P(b, sizeof b, PSTR("P%u code %06lu"), p, code); n++; break; }
    }
    (void)n;
  } else if (row == 7) {
    unsigned int bad = RPULink_BadFrames(), drop = RPULink_DroppedRecords();
    if (bad || drop) snprintf_P(b, sizeof b, PSTR("bad %u drop %u"), bad, drop);
  }
  for (byte i = 0; i < 16 && b[i]; i++) t[i] = b[i];
}

inline void PinNode_OledUpdate(unsigned long now) {
  PinNodeOledState &s = PinNode_OledState();
  if (now - s.lastMs < 25) return;
  s.lastMs = now;
  for (byte k = 0; k < 8; k++) {                        // the next row that changed: one per pass
    byte row = (byte)((s.next + k) % 8);
    char t[17];
    PinNode_OledLine(row, t, now);
    uint16_t sum = 0;
    for (byte i = 0; i < 16; i++) sum = (uint16_t)((sum << 3) + (sum >> 13) + (byte)t[i]);
    if (sum != s.shown[row]) {
      PinNode_Oled().drawString(0, row, t);
      s.shown[row] = sum;
      s.next = (byte)((row + 1) % 8);
      return;
    }
  }
}
#else
#define PinNode_OledBegin()                ((void)0)
#define PinNode_OledUpdate(...)            ((void)0)
#endif
#endif

